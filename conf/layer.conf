## conf/layer.conf
```bitbake
# We have a conf and classes directory, add to BBPATH
BBPATH := "${BBPATH}:${LAYERDIR}"

# We have an images and various recipe-* directories, add to BBFILES
BBFILES := "${BBFILES} ${LAYERDIR}/recipes*/*/*.bb*"
	
BBFILE_COLLECTIONS += "cgx24-msd-x86-generic"
BBFILE_PATTERN_cgx24-msd-x86-generic := "^${LAYERDIR}/"
BBFILE_PRIORITY_cgx24-msd-x86-generic = "7"

LAYERSERIES_COMPAT_cgx24-msd-x86-generic = "thud"

LAYERDEPENDS_template = "core "
```
